## drivers/staging/rtcomm/Kconfig
```kconfig
#
# Real-time drivers
#
menu "Real-time communication driver"

config RTCOMM
    tristate "Real-time communication driver"
    depends on SPI 
    help
      Real-time communication driver something

      To compile this driver as a module, choose M here: the 
      module will be called rtcomm.

endmenu
```

## drivers/staging/spi_test/Kconfig
```kconfig
config SPI_TESTN
	tristate "SPI testing"
	depends on SPI
	---help---

	  Module will be called spi_test.
```
